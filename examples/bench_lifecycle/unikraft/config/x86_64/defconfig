## examples/bench_lifecycle/unikraft/config/x86_64/defconfig
```kconfig
CONFIG_PLAT_CARRELS=y
CONFIG_ARCH_X86_64=y
CONFIG_UKPLAT_CPU_MAXCOUNT=1
CONFIG_LIBUKBOOT_MAINTHREAD=y
CONFIG_LIBUKBOOT_MAINTHREAD_NOHALT=y
CONFIG_LIBUKBOOT_BANNER_NONE=y
CONFIG_LIBUKCONSOLE=y
CONFIG_LIBSDDFSERIAL=y
CONFIG_LIBSDDFSERIAL_EARLY_CONSOLE=y
CONFIG_LIBUKNETDEV=y
```
